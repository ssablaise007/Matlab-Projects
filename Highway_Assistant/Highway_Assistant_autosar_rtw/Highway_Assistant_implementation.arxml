AUTOSAR XML (schema 00050)
package /Components/SwcImplementations
  swc implementation Highway_Assistant_Impl: programming-language=C, sw-version=1.17.1, used-code-generator=Embedded Coder 23.2 (R2023b) 01-Aug-2023, vendor-id=0, behavior=Highway_Assistant_IB
    code-descriptors:
      code Code
        artifact-descriptors:
          short-label=Highway_Assistant_c, category=SWSRC
          short-label=Highway_Assistant_h, category=SWHDR
          short-label=Highway_Assistant_private_h, category=SWHDR
          short-label=Highway_Assistant_types_h, category=SWHDR
    resource consumption RsrcCons_Highway_Assistant
